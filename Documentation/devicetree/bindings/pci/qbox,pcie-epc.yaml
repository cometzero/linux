## Documentation/devicetree/bindings/pci/qbox,pcie-epc.yaml
```yaml
# SPDX-License-Identifier: (GPL-2.0-only OR BSD-2-Clause)
%YAML 1.2
---
$id: http://devicetree.org/schemas/pci/qbox,pcie-epc.yaml#
$schema: http://devicetree.org/meta-schemas/core.yaml#

title: QBox virtual PCIe endpoint controller

maintainers:
  - Chanho Park <parkch98@gmail.com>

properties:
  compatible:
    const: qbox,pcie-epc

  reg:
    items:
      - description: EPC control registers
      - description: Outbound PCI address translation aperture

  reg-names:
    items:
      - const: ctrl
      - const: mem

required:
  - compatible
  - reg
  - reg-names

additionalProperties: false

examples:
  - |
    pcie-epc@30300000 {
        compatible = "qbox,pcie-epc";
        reg = <0x30300000 0x1000>,
              <0x30400000 0x400000>;
        reg-names = "ctrl", "mem";
    };
```

## Documentation/devicetree/bindings/pinctrl/hsoc,peri0-gpio.yaml
```yaml
# SPDX-License-Identifier: (GPL-2.0-only OR BSD-2-Clause)
%YAML 1.2
---
$id: http://devicetree.org/schemas/pinctrl/hsoc,peri0-gpio.yaml#
$schema: http://devicetree.org/meta-schemas/core.yaml#

title: HSOC PERI GPIO and Pin Controller

maintainers:
  - Chanho Park <parkch98@gmail.com>

description:
  The HSOC PERI controllers provide pin multiplexing, pin configuration,
  GPIO access, and one aggregated interrupt per GPIO bank. The hardware does
  not expose its bank topology, so every bank and its width are described by
  GPIO child nodes. GPIO range pin offsets are cumulative across the actual
  hsoc,npins bank widths. Pinmux values retain the hardware bank stride and
  encode a pin as bank times eight plus its offset within that bank.

properties:
  compatible:
    enum:
      - hsoc,peri0-gpio
      - hsoc,peri1-gpio

  reg:
    maxItems: 1

  interrupts:
    minItems: 8
    maxItems: 14

  '#address-cells':
    const: 1

  '#size-cells':
    const: 0

patternProperties:
  '^gpio@[0-9a-d]+$':
    type: object
    additionalProperties: false
    properties:
      reg:
        minimum: 0
        maximum: 13

      hsoc,npins:
        $ref: /schemas/types.yaml#/definitions/uint32
        minimum: 1
        maximum: 8

      gpio-controller: true

      '#gpio-cells':
        const: 2

      interrupt-controller: true

      '#interrupt-cells':
        const: 2

      gpio-ranges:
        maxItems: 1

      gpio-line-names:
        minItems: 1
        maxItems: 8

    required:
      - reg
      - hsoc,npins
      - gpio-controller
      - '#gpio-cells'
      - interrupt-controller
      - '#interrupt-cells'
      - gpio-ranges

  '-pins$':
    type: object
    allOf:
      - $ref: pinmux-node.yaml#
      - $ref: pincfg-node.yaml#
    properties:
      pinmux:
        minItems: 1

      bias-disable: true
      bias-pull-down: true
      bias-pull-up: true
      drive-push-pull: true
      input-disable: true
      input-enable: true
      input-schmitt-disable: true
      input-schmitt-enable: true

      drive-strength: false
      slew-rate: false

      hsoc,drive-strength:
        $ref: /schemas/types.yaml#/definitions/uint32
        description: Drive strength selector, from 1x through 4x.
        minimum: 0
        maximum: 3

      hsoc,interrupt-filter-type:
        $ref: /schemas/types.yaml#/definitions/uint32
        description: Select logic-delay (0) or time-delay (1) filtering.
        enum: [0, 1]

      hsoc,interrupt-filter-depth:
        $ref: /schemas/types.yaml#/definitions/uint32
        description: Filter depth, where zero disables filtering.
        minimum: 0
        maximum: 15

    required:
      - pinmux

    additionalProperties: false

allOf:
  - $ref: pinctrl.yaml#
  - if:
      properties:
        compatible:
          const: hsoc,peri0-gpio
    then:
      properties:
        interrupts:
          minItems: 14
          maxItems: 14
    else:
      properties:
        interrupts:
          minItems: 8
          maxItems: 8

required:
  - compatible
  - reg
  - interrupts
  - '#address-cells'
  - '#size-cells'

additionalProperties: false

examples:
  - |
    #include <dt-bindings/interrupt-controller/arm-gic.h>
    #include <dt-bindings/pinctrl/hsoc.h>

    pinctrl_peri0: gpio@301e0000 {
        compatible = "hsoc,peri0-gpio";
        reg = <0x301e0000 0x10000>;
        interrupts = <GIC_SPI 334 IRQ_TYPE_LEVEL_HIGH>,
                     <GIC_SPI 335 IRQ_TYPE_LEVEL_HIGH>,
                     <GIC_SPI 336 IRQ_TYPE_LEVEL_HIGH>,
                     <GIC_SPI 337 IRQ_TYPE_LEVEL_HIGH>,
                     <GIC_SPI 338 IRQ_TYPE_LEVEL_HIGH>,
                     <GIC_SPI 339 IRQ_TYPE_LEVEL_HIGH>,
                     <GIC_SPI 340 IRQ_TYPE_LEVEL_HIGH>,
                     <GIC_SPI 341 IRQ_TYPE_LEVEL_HIGH>,
                     <GIC_SPI 342 IRQ_TYPE_LEVEL_HIGH>,
                     <GIC_SPI 343 IRQ_TYPE_LEVEL_HIGH>,
                     <GIC_SPI 344 IRQ_TYPE_LEVEL_HIGH>,
                     <GIC_SPI 345 IRQ_TYPE_LEVEL_HIGH>,
                     <GIC_SPI 346 IRQ_TYPE_LEVEL_HIGH>,
                     <GIC_SPI 347 IRQ_TYPE_LEVEL_HIGH>;
        #address-cells = <1>;
        #size-cells = <0>;

        gpio@0 {
            reg = <0>;
            hsoc,npins = <8>;
            gpio-controller;
            #gpio-cells = <2>;
            interrupt-controller;
            #interrupt-cells = <2>;
            gpio-ranges = <&pinctrl_peri0 0 0 8>;
        };

        i2c0-pins {
            pinmux = <HSOC_PINMUX(0, 0, 2)>,
                     <HSOC_PINMUX(0, 1, 2)>;
            hsoc,drive-strength = <1>;
            input-enable;
        };
    };
```

## Documentation/devicetree/bindings/pinctrl/hsoc,peri0-pinctrl.yaml
```yaml
# SPDX-License-Identifier: (GPL-2.0-only OR BSD-2-Clause)
%YAML 1.2
---
$id: http://devicetree.org/schemas/pinctrl/hsoc,peri0-pinctrl.yaml#
$schema: http://devicetree.org/meta-schemas/core.yaml#

title: HSOC PERI Pin Controller

maintainers:
  - Chanho Park <parkch98@gmail.com>

description:
  The HSOC PERI controllers provide pin multiplexing, drive strength and slew
  configuration, GPIO access, and one aggregated interrupt per GPIO bank.
  The number and width of banks are described by the GPIO child nodes.
  GPIO range pin offsets are cumulative across the actual hsoc,npins bank
  widths. Pinmux values retain the hardware bank stride and encode a pin as
  bank times eight plus its offset within that bank.

properties:
  compatible:
    enum:
      - hsoc,peri0-pinctrl
      - hsoc,peri1-pinctrl

  reg:
    maxItems: 1

  interrupts:
    minItems: 8
    maxItems: 14

  '#address-cells':
    const: 1

  '#size-cells':
    const: 0

patternProperties:
  '^gpio@[0-9a-d]+$':
    type: object
    additionalProperties: false
    properties:
      reg:
        minimum: 0
        maximum: 13

      hsoc,npins:
        minimum: 1
        maximum: 8

      gpio-controller: true

      '#gpio-cells':
        const: 2

      interrupt-controller: true

      '#interrupt-cells':
        const: 2

      gpio-ranges:
        maxItems: 1

      gpio-line-names:
        minItems: 1
        maxItems: 8

    required:
      - reg
      - hsoc,npins
      - gpio-controller
      - '#gpio-cells'
      - interrupt-controller
      - '#interrupt-cells'
      - gpio-ranges

  '-pins$':
    type: object
    $ref: pinmux-node.yaml#
    unevaluatedProperties: false
    properties:
      pinmux:
        minItems: 1

      drive-strength:
        enum: [2, 4, 8, 12, 16]

      slew-rate:
        enum: [0, 1]

    required:
      - pinmux

allOf:
  - $ref: pinctrl.yaml#
  - if:
      properties:
        compatible:
          const: hsoc,peri0-pinctrl
    then:
      properties:
        interrupts:
          minItems: 14
          maxItems: 14
    else:
      properties:
        interrupts:
          minItems: 8
          maxItems: 8

required:
  - compatible
  - reg
  - interrupts
  - '#address-cells'
  - '#size-cells'

additionalProperties: false

examples:
  - |
    #include <dt-bindings/interrupt-controller/arm-gic.h>
    #include <dt-bindings/pinctrl/hsoc.h>

    pinctrl_peri0: pinctrl@301e0000 {
        compatible = "hsoc,peri0-pinctrl";
        reg = <0x301e0000 0x10000>;
        interrupts = <GIC_SPI 334 IRQ_TYPE_LEVEL_HIGH>,
                     <GIC_SPI 335 IRQ_TYPE_LEVEL_HIGH>,
                     <GIC_SPI 336 IRQ_TYPE_LEVEL_HIGH>,
                     <GIC_SPI 337 IRQ_TYPE_LEVEL_HIGH>,
                     <GIC_SPI 338 IRQ_TYPE_LEVEL_HIGH>,
                     <GIC_SPI 339 IRQ_TYPE_LEVEL_HIGH>,
                     <GIC_SPI 340 IRQ_TYPE_LEVEL_HIGH>,
                     <GIC_SPI 341 IRQ_TYPE_LEVEL_HIGH>,
                     <GIC_SPI 342 IRQ_TYPE_LEVEL_HIGH>,
                     <GIC_SPI 343 IRQ_TYPE_LEVEL_HIGH>,
                     <GIC_SPI 344 IRQ_TYPE_LEVEL_HIGH>,
                     <GIC_SPI 345 IRQ_TYPE_LEVEL_HIGH>,
                     <GIC_SPI 346 IRQ_TYPE_LEVEL_HIGH>,
                     <GIC_SPI 347 IRQ_TYPE_LEVEL_HIGH>;
        #address-cells = <1>;
        #size-cells = <0>;

        gpio@0 {
            reg = <0>;
            hsoc,npins = <8>;
            gpio-controller;
            #gpio-cells = <2>;
            interrupt-controller;
            #interrupt-cells = <2>;
            gpio-ranges = <&pinctrl_peri0 0 0 8>;
        };

        i2c0-pins {
            pinmux = <HSOC_PINMUX(0, 0, 2)>,
                     <HSOC_PINMUX(0, 1, 2)>;
            drive-strength = <4>;
            slew-rate = <0>;
        };
    };
```

## drivers/accel/apollo_hexagon/Kconfig
```kconfig
# SPDX-License-Identifier: GPL-2.0-only

config DRM_ACCEL_APOLLO_HEXAGON
	bool "Apollo Hexagon DRM accel driver"
	depends on DRM_ACCEL
	depends on OF
	depends on HAS_DMA
	depends on MMU
	depends on ARM64 || COMPILE_TEST
	select IOMMU_API
	select DRM_GEM_SHMEM_HELPER
	help
	  Build the Apollo Hexagon platform driver as a DRM compute
	  accelerator exposed through /dev/accel/accel*.  The driver binds
	  the apollo,hexagon-ip device behind the ARM SMMUv3 path, preserves
	  the repo-local CNN, vector-add, and DMA stress compatibility ioctls,
	  and exposes append-only generic APKO executable, context, GEM buffer
	  object, BO binding, command BO submit, query-caps, wait, and
	  fault-retrieval ioctls for the DNN kernel execution path.

config DRM_ACCEL_APOLLO_HEXAGON_SELFTEST
	bool "Apollo Hexagon DRM accel SMMUv3 bring-up selftests"
	depends on DRM_ACCEL_APOLLO_HEXAGON
	help
	  Run Apollo Hexagon bring-up checks from the driver probe path.  These
	  checks exercise QBox-specific firmware DMA markers, SMMUv3 descriptor
	  staging, architected queues, ATS/PRI/fault paths, and RIL TLBI range
	  commands.

	  Leave this disabled for the normal runtime driver.  Generic IOMMU DMA
	  coverage should use the drivers/iommu/iommu-test.c runtime test driver
	  instead.
```

## drivers/soc/apollo/Kconfig
```kconfig
# SPDX-License-Identifier: GPL-2.0-only

config SOC_APOLLO
	bool "Apollo SoC support"
	depends on ARM64 || COMPILE_TEST
	help
	  Enable support for the Apollo SoC models used by the apollo-qbox
	  virtual platform.
```
