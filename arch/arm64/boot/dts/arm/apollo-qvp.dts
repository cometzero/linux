// SPDX-License-Identifier: (GPL-2.0 OR BSD-3-Clause)
/*
 * Copyright (c) 2025-2026, Arm Limited. All rights reserved.
 */

/* Compatibility entry; use hsoc/apollo-qvp-saturn-v.dts for new builds. */
#include "../hsoc/apollo-qvp-saturn-v.dts"
